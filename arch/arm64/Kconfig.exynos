## arch/arm64/Kconfig.exynos
```kconfig
config MACH_EXYNOS7885_A20E_OPEN
	bool "Build dtbo.img for a20e"
	depends on SOC_EXYNOS7885
	default n
	help
	Say Y here if you want to enable building dtbo for galaxy a20e.
```
